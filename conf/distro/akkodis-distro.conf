## conf/distro/akkodis-distro.conf
```bitbake
DISTRO_VERSION = "walnascar"
DISTRO_NAME = "Akkodis Edge distro"

DISTRO_FEATURES = " \
	3g ipv4 ipv6 pam pni-names polkit seccomp systemd systemd-resolved \
	usrmerge \
	${@bb.utils.filter('MACHINE_FEATURES', 'alsa bluetooth ext2 keyboard pci usbhost vfat', d)} \
	${@bb.utils.filter('MACHINE_FEATURES', 'wifi', d)} \
	${@bb.utils.contains('MACHINE_FEATURES', 'screen', 'opengl vulkan wayland', '',d)} \
	${@bb.utils.contains('MACHINE_FEATURES', 'alsa', 'pulseaudio', '',d)} \
"

# Build fails when assembling rootfs for 
# images including external kernel modules.
# All recipes are verified to have valid sdpx data
# where the match is based on spdx name being
# equal to PN.
# External modules append kernel version to PN
# during build time and spdx creating but not 
# when verifying PN to spdx name.
#
# Disable for now.
INHERIT_DISTRO:remove = "create-spdx"

# Disable pulseaudio when alsa/audio not present 
DISTRO_FEATURES_BACKFILL_CONSIDERED = "${@bb.utils.contains('MACHINE_FEATURES', 'alsa', '', 'pulseaudio',d)}"

INIT_MANAGER = "systemd"

# Use systemd-resolved recommended mode of operation
# which allows per-interface name servers.
RESOLV_CONF = "stub-resolv"

PACKAGECONFIG:remove:pn-systemd = "\
	binfmt \
	backlight \
	vconsole \
	quotacheck \
	hibernate \
	ima \
	smack \
	networkd \
"

# Make sure serial-getty@.service is installed.
PACKAGECONFIG:append:pn-systemd = " serial-getty-generator"

# systemd checks for efi in DISTRO_FEATURES which is a MACHINE_FEATURE,
# add the correct check here.
PACKAGECONFIG:append:pn-systemd = " ${@bb.utils.filter('MACHINE_FEATURES', 'efi', d)}"

# Boot into our systemd target
SYSTEMD_DEFAULT_TARGET ?= "akkodis-apps.target"

# Build networkmanager with modemmanager support
PACKAGECONFIG:append:pn-networkmanager = " modemmanager"
# Do not manage bluetooth in networkmanager
PACKAGECONFIG:remove:pn-networkmanager = "bluez5"
# Disable mbim dependency as we use qmi for modems
PACKAGECONFIG:remove:pn-modemmanager = "mbim"
PACKAGECONFIG:remove:pn-libqmi = "mbim"
# Disable unused vala bindings
PACKAGECONFIG:remove:pn-modemmanager = "vala"
PACKAGECONFIG:remove:pn-networkmanager = "vala"
# dnsmasq started by networkmanager if needed
SYSTEMD_AUTO_ENABLE:pn-dnsmasq = "disable"

# We don't want to route qt5 to x11 through wayland
PACKAGECONFIG:remove:pn-qtwayland = "xcomposite-egl xcomposite-glx"

# Build python3 bindings for libiio
PACKAGECONFIG:append:pn-libiio = " libiio-python3"

# Add python bindings generator for grpc-native recipes
PACKAGECONFIG:append:pn-grpc-native = " python"

# Replace busybox will full base-utils
PREFERRED_PROVIDER_virtual/base-utils = "packagegroup-akkodis-base-utils"
VIRTUAL-RUNTIME_base-utils = "packagegroup-akkodis-base-utils"
VIRTUAL-RUNTIME_base-utils-hwclock = "util-linux-hwclock"
VIRTUAL-RUNTIME_base-utils-syslog = ""

# obex-profiles pulls in libical which in turn pulls in 
# icu which adds ~30MB to image size.
# Investigate further if needed, disable OBEX for now.
PACKAGECONFIG:remove:pn-bluez5 = "obex-profiles"

# Make PAM output login events to audit subsystem.
PACKAGECONFIG:append:pn-libpam = " audit"

# Run pulseaudio in --system mode
# Block --user mode services
SYSTEMD_AUTO_ENABLE:pn-pulseaudio = "mask"

# We are using ModemManager, disable ofono
# pulseaudio draws in ofono when DISTRO_FEATURES 3g is set.
PACKAGECONFIG:remove:pn-pulseaudio = "ofono"
# Remove packagegroup-base-3g which depends on ofono
RDEPENDS:packagegroup-base-3g:remove = "ofono"

# Set default preference for wireless-regdb.
# Override from MACHINE if required for regulatory purposes.
PREFERRED_RPROVIDER_wireless-regdb-static ??= "wireless-regdb"

# Include p11-kit support in gnutls to build p11tool.
PACKAGECONFIG:append:pn-gnutls = " p11-kit"
```

## conf/distro/datarespons-distro.conf
```bitbake
DISTRO_VERSION = "scarthgap"
DISTRO_NAME = "Data Respons distro"

DISTRO_FEATURES = " \
	${@bb.utils.contains('MACHINE_FEATURES', 'screen', 'wayland opengl pulseaudio', '',d)} \
	${@bb.utils.contains('MACHINE_FEATURES', '3g', 'polkit', '',d)} \
	${@bb.utils.filter('MACHINE_FEATURES', 'pci wifi bluetooth ext2 usbhost alsa efi', d)} \
	argp largefile xattr gobject-introspection-data pam usrmerge \
	systemd polkit \
"

# Build fails when assembling rootfs for 
# images including external kernel modules.
# All recipes are verified to have valid sdpx data
# where the match is based on spdx name being
# equal to PN.
# External modules append kernel version to PN
# during build time and spdx creating but not 
# when verifying PN to spdx name.
#
# Disable for now.
INHERIT_DISTRO:remove = "create-spdx"

DISTRO_FEATURES_BACKFILL_CONSIDERED = "pulseaudio"
INIT_MANAGER = "systemd"

PACKAGECONFIG:remove:pn-systemd = "\
	binfmt \
	backlight \
	vconsole \
	quotacheck \
	hibernate \
	ima \
	smack \
	networkd \
"

# Make sure serial-getty@.service is installed.
PACKAGECONFIG:append:pn-systemd = " serial-getty-generator"

# Boot into our systemd target
SYSTEMD_DEFAULT_TARGET ?= "datarespons-apps.target"

# Build networkmanager with modemmanager support
PACKAGECONFIG:append:pn-networkmanager = " modemmanager"
# We rely on dns from dhcp
PACKAGECONFIG:remove:pn-networkmanager = "dnsmasq"
# Do not manage bluetooth in networkmanager
PACKAGECONFIG:remove:pn-networkmanager = "bluez5"
# Disable mbim dependency as we use qmi for modems
PACKAGECONFIG:remove:pn-modemmanager = "mbim"
PACKAGECONFIG:remove:pn-libqmi = "mbim"
# Disable unused vala bindings
PACKAGECONFIG:remove:pn-modemmanager = "vala"
PACKAGECONFIG:remove:pn-networkmanager = "vala"

# We don't want to route qt5 to x11 through wayland
PACKAGECONFIG:remove:pn-qtwayland = "xcomposite-egl xcomposite-glx"

# Build python3 bindings for libiio
PACKAGECONFIG:append:pn-libiio = " libiio-python3"

# Add python bindings generator for grpc-native recipes
PACKAGECONFIG:append:pn-grpc-native = " python"

# Replace busybox will full base-utils
PREFERRED_PROVIDER_virtual/base-utils = "packagegroup-datarespons-base-utils"
VIRTUAL-RUNTIME_base-utils = "packagegroup-datarespons-base-utils"
VIRTUAL-RUNTIME_base-utils-hwclock = "util-linux-hwclock"
VIRTUAL-RUNTIME_base-utils-syslog = ""

# obex-profiles pulls in libical which in turn pulls in 
# icu which adds ~30MB to image size.
# Investigate further if needed, disable OBEX for now.
PACKAGECONFIG:remove:pn-bluez5 = "obex-profiles"

# polkit has options for js-engine.
# The default "mozjs" is ~15MB and pulls in icu which adds ~30MB to image size.
# Switch to alternative "duktape".
PACKAGECONFIG:remove:pn-polkit = "mozjs"
PACKAGECONFIG:append:pn-polkit = " duktape"
```

## conf/layer.conf
```bitbake
# We have a conf and classes directory, add to BBPATH
BBPATH .= ":${LAYERDIR}"

# We have a packages directory, add to BBFILES
BBFILES += "${LAYERDIR}/recipes-*/*/*.bb \
            ${LAYERDIR}/recipes-*/*/*.bbappend"

BBFILE_COLLECTIONS += "akkodis-layer"
BBFILE_PATTERN_akkodis-layer := "^${LAYERDIR}/"
BBFILE_PRIORITY_akkodis-layer = "7"

LAYERDEPENDS_akkodis-layer = "core networking-layer openembedded-layer bsp-common-layer"
LAYERSERIES_COMPAT_akkodis-layer = "kirkstone mickledore nanbield scarthgap walnascar"

# Let us add layer-specific bbappends which are only applied when that
# layer is included in our configuration
BBFILES += "${@' '.join('${LAYERDIR}/%s/recipes*/*/*.bbappend' % layer \
               for layer in BBFILE_COLLECTIONS.split())}"

SECURE_BOOT_SIGNING_KEY ??= "${LAYERDIR}/recipes-security/efi-keys/files/db.key"
SECURE_BOOT_SIGNING_CERT ??= "${LAYERDIR}/recipes-security/efi-keys/files/db.crt"
```
